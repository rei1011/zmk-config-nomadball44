## boards/shields/nomadball44/Kconfig.defconfig
```kconfig
if SHIELD_NOMADBALL44_RIGHT

config ZMK_KEYBOARD_NAME
    default "nomadball44"

config ZMK_SPLIT_ROLE_CENTRAL
    default y

endif # SHIELD_NOMADBALL44_RIGHT

# 左手 USB ホスト検証用（量産の左手ペリフェラルとは別シールド）
if SHIELD_NOMADBALL44_LEFT_HOST_TEST

config ZMK_SPLIT_ROLE_CENTRAL
    default y

config ZMK_BATTERY_REPORTING
    default n

endif # SHIELD_NOMADBALL44_LEFT_HOST_TEST

# 左手 BLE ホスト検証用（Mac 等へ直接ペア）
if SHIELD_NOMADBALL44_LEFT_BLE_HOST_TEST

config ZMK_SPLIT_ROLE_CENTRAL
    default y

config ZMK_BLE
    default y

config ZMK_BATTERY_REPORTING
    default n

endif # SHIELD_NOMADBALL44_LEFT_BLE_HOST_TEST

# 非 split 左手単体検証（BLE ホストへ直接アドバタイズ可能）
if SHIELD_NOMADBALL44_LEFT_STANDALONE

config ZMK_SPLIT
    default n

config NFCT_PINS_AS_GPIOS
    default y

config ZMK_BLE
    default y

# BT デバイス名は最大 16 文字（ble.c の BUILD_ASSERT）
config ZMK_KEYBOARD_NAME
    default "nom44-L-std-bt"

endif # SHIELD_NOMADBALL44_LEFT_STANDALONE

if SHIELD_NOMADBALL44_LEFT || SHIELD_NOMADBALL44_RIGHT || SHIELD_NOMADBALL44_LEFT_HOST_TEST || SHIELD_NOMADBALL44_LEFT_BLE_HOST_TEST

config ZMK_SPLIT
    default y

config NFCT_PINS_AS_GPIOS
    default y

endif # nomadball44 left / right / host-test shields
```

## boards/shields/nomadball44/Kconfig.shield
```kconfig
config SHIELD_NOMADBALL44_LEFT
    def_bool $(shields_list_contains,nomadball44_left)

config SHIELD_NOMADBALL44_LEFT_HOST_TEST
    def_bool $(shields_list_contains,nomadball44_left_host_test)

config SHIELD_NOMADBALL44_LEFT_BLE_HOST_TEST
    def_bool $(shields_list_contains,nomadball44_left_ble_host_test)

config SHIELD_NOMADBALL44_LEFT_STANDALONE
    def_bool $(shields_list_contains,nomadball44_left_standalone)

config SHIELD_NOMADBALL44_RIGHT
    def_bool $(shields_list_contains,nomadball44_right)

config SHIELD_NOMADBALL44_RIGHT_HOST_TEST
    def_bool $(shields_list_contains,nomadball44_right_host_test)

config SHIELD_NOMADBALL44_RIGHT_BLE_HOST_TEST
    def_bool $(shields_list_contains,nomadball44_right_ble_host_test)

config SHIELD_NOMADBALL44_RIGHT_STANDALONE
    def_bool $(shields_list_contains,nomadball44_right_standalone)
```
